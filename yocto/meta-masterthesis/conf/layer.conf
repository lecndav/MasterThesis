## yocto/meta-masterthesis/conf/layer.conf
```bitbake
# We have a conf and classes directory, add to BBPATH
BBPATH .= ":${LAYERDIR}"

# We have recipes-* directories, add to BBFILES
BBFILES += "${LAYERDIR}/recipes-*/*/*.bb \
	${LAYERDIR}/recipes-*/*/*.bbappend"

BBFILE_COLLECTIONS += "prj-masterthesis"
BBFILE_PATTERN_prj-masterthesis= "^${LAYERDIR}/"
BBFILE_PRIORITY_prj-masterthesis = "8"

LAYERSERIES_COMPAT_prj-masterthesis = " pyro rocko sumo thud warrior"
```
